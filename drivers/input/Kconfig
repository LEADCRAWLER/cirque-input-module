## drivers/input/Kconfig
```kconfig
# Copyright (c) 2022 The ZMK Contributors
# SPDX-License-Identifier: MIT

menuconfig INPUT_PINNACLE
    bool "Cirque Pinnacle trackpads"
    default y
    depends on GPIO
    depends on SPI || I2C
    depends on INPUT
    depends on DT_HAS_CIRQUE_PINNACLE_ENABLED
    help
      Enable driver for Cirque Pinnacle trackpads

if INPUT_PINNACLE

config INPUT_PINNACLE_INIT_PRIORITY
    int "Cirque Pinnacle initialization priority"
    default INPUT_INIT_PRIORITY

config INPUT_PINNACLE_PM
    bool "Enable power management for Pinnacle trackpad"
    default y
    depends on PM_DEVICE
    help
      Enable device power management support for the Cirque Pinnacle
      trackpad. When enabled, the trackpad enters shutdown mode (~0.23 µA)
      during system suspend. If supply-gpios is configured in the devicetree,
      VDD is also cut on suspend for true 0 µA draw.

if ZMK_MOUSE

config ZMK_INPUT_PINNACLE_IDLE_SLEEPER
    bool "Pinnacle Sleep linked to ZMK idle state"
    default n

endif

endif
```

## dts/bindings/input/cirque,pinnacle-common.yaml
```yaml
properties:
  dr-gpios:
    type: phandle-array
    description: Data ready pin for the trackpad
  supply-gpios:
    type: phandle-array
    description: |
      Optional GPIO controlling the trackpad VDD supply (e.g. a load switch or
      MOSFET). When configured, power is cut on suspend and restored on resume,
      achieving true 0 µA draw. The GPIO is driven active (high for active-high
      switches) when power should be on.
  rotate-90:
    type: boolean
  x-invert:
    type: boolean
  y-invert:
    type: boolean
  sleep:
    type: boolean
  no-secondary-tap:
    type: boolean
  no-taps:
    type: boolean
  no-glide-extend:
    type: boolean
    description: |
      Disable GlideExtend gesture detection. GlideExtend keeps the analog
      front-end active after finger lift to detect glide gestures, consuming
      extra power. Disable if not needed to save power on every finger lift.
  no-scroll:
    type: boolean
    description: |
      Disable the Pinnacle's internal scroll detection engine. When the host
      handles scrolling in software, the on-chip scroll engine is unnecessary
      overhead. Disabling it reduces continuous processing power.
  sensitivity:
    type: string
    enum:
      - 1x
      - 2x
      - 3x
      - 4x
    description: ADC attenuation (sensitivity) setting.
  x-axis-z-min:
    type: int
    default: 5
  y-axis-z-min:
    type: int
    default: 4
  absolute-mode:
    type: boolean
  abs-rel-divisor:
    type: int
    description: If non zero, uses pad in absmode, but sends relative events (and touch press/release)
    default: 0
  idle-packets-count:
    type: int
    default: 0
    description: |
      Number of Z=0 (z-idle) packets emitted after a finger lifts. Only applied
      in pure absolute mode — relative and abs-rel modes require a minimum count
      for lift detection and ignore this property. Default 0 suppresses all
      unnecessary MCU wakeups in absolute mode. Maximum 255.
  sleep-interval:
    type: int
    default: 50
    description: |
      Sleep mode scan interval written to register 0x0C (Sleep Interval).
      Higher values increase the time between touch scans during hardware sleep,
      reducing average current below the 40 µA baseline but increasing wake
      latency. Default 50 gives ~300ms wake latency. Maximum 255.
  sleep-timer:
    type: int
    default: 39
    description: |
      Sleep mode entry delay written to register 0x0D (Sleep Timer).
      Controls how quickly the device enters sleep mode after no touch is
      detected. Lower values enter sleep faster, saving power by reducing
      time in the 1.7mA idle state. Value is in units of the Sleep Interval
      period. Default 39 matches the Pinnacle factory default. Maximum 255.
  adaptive-sample-rate:
    type: boolean
    description: |
      Enable adaptive sample rate in absolute or abs-rel mode. When enabled,
      the driver reduces the sample rate (SAMPLE register 0x09) to low-sample-rate
      after PINNACLE_ADAPTIVE_IDLE_THRESHOLD consecutive samples with movement
      below PINNACLE_ADAPTIVE_MOVE_THRESHOLD, and restores high-sample-rate on
      movement. Only effective in absolute or abs-rel modes.
  high-sample-rate:
    type: int
    default: 100
    description: |
      Full-speed sample rate (samples/sec) used during active touch movement.
      Written to register 0x09. Default 100 matches the Pinnacle power-on default.
  low-sample-rate:
    type: int
    default: 25
    description: |
      Reduced sample rate (samples/sec) used when touch movement is below the
      adaptive threshold. Written to register 0x09 during idle periods to reduce
      Active-mode current.
  absolute-mode-scale-to-width:
    type: int
    default: 1024
    description: Scale reported x values to [0-1024]
  absolute-mode-scale-to-height:
    type: int
    default: 1024
    description: Scale reported y values to [0-1024]
  absolute-mode-clamp-min-x:
    type: int
    default: 128
    description: |
      Specification says that active reporting of absolute position
      is: 128 ≤ X ≤1920 and 64 ≤ Y ≤ 1472, but on my touchpad, I need other values.
  absolute-mode-clamp-max-x:
    type: int
    default: 1920
    description: |
      Specification says that active reporting of absolute position
      is: 128 ≤ X ≤1920 and 64 ≤ Y ≤ 1472, but on my touchpad, I need other values.
  absolute-mode-clamp-min-y:
    type: int
    default: 64
    description: |
      Specification says that active reporting of absolute position
      is: 128 ≤ X ≤1920 and 64 ≤ Y ≤ 1472, but on my touchpad, I need other values.
  absolute-mode-clamp-max-y:
    type: int
    default: 1472
    description: |
      Specification says that active reporting of absolute position
      is: 128 ≤ X ≤1920 and 64 ≤ Y ≤ 1472, but on my touchpad, I need other values.
```
